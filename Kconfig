## Kconfig
```kconfig
menu "Logger Common Configuration"
    choice
        bool "Default log verbosity"
        default LOGGER_COMMON_LOG_LEVEL_WARN
        help
            Specify how important log should be added.
        config LOGGER_COMMON_LOG_LEVEL_TRACE
            bool "A lot of logs to give detailed information"
        config LOGGER_COMMON_LOG_LEVEL_INFO
            bool "Log important events"
        config LOGGER_COMMON_LOG_LEVEL_WARN
            bool "Log if something unwanted happened but didn't cause a problem"
        config LOGGER_COMMON_LOG_LEVEL_ERROR
            bool "Only critical issues, when the system may fail"
        config LOGGER_COMMON_LOG_LEVEL_USER
            bool "Only logs added by the user"
        config LOGGER_COMMON_LOG_LEVEL_NONE
            bool "Do not log anything"
    endchoice
    config LOGGER_COMMON_LOG_LEVEL
        int
        default 0 if LOGGER_COMMON_LOG_LEVEL_TRACE
        default 1 if LOGGER_COMMON_LOG_LEVEL_INFO
        default 2 if LOGGER_COMMON_LOG_LEVEL_WARN
        default 3 if LOGGER_COMMON_LOG_LEVEL_ERROR
        default 4 if LOGGER_COMMON_LOG_LEVEL_USER
        default 5 if LOGGER_COMMON_LOG_LEVEL_NONE
    choice
            default HAS_BOARD_LILYGO_T_DISPLAY_S3 if IDF_TARGET_ESP32S3
            default HAS_BOARD_LILYGO_EPAPER_T5 if IDF_TARGET_ESP32
            prompt "Select board"
            config HAS_BOARD_LILYGO_EPAPER_T5
                depends on IDF_TARGET_ESP32
            bool "Board is Lilygo Epaper T5"
            config HAS_BOARD_LILYGO_T_DISPLAY_S3
                depends on IDF_TARGET_ESP32S3
            bool "Board is Lilygo T-Display S3"
    endchoice
    menu "Enable BMX280 Temperature sensor"
            comment "Bmx temperature sensor"
            config BMX_ENABLE
                bool "Enable BMX280 temp sensor"
                default y if HAS_BOARD_LILYGO_T_DISPLAY_S3
                help
                    This option enables BMX280 temp sensor.:
        menu "BMX temperature sensor pins"
            depends on BMX_ENABLE
            comment "GPS send and transmit pin configuration"
            config BMX_SDA
                int "Bmx280 SDA pin"
                default 43 if HAS_BOARD_LILYGO_T_DISPLAY_S3
                default 21
                help
                Specify the SDA pin for Bmx280 sensor.
            config BMX_SCL
                int "Bmx280 SCL pin"
                default 44 if HAS_BOARD_LILYGO_T_DISPLAY_S3
                default 22
                help
                Specify the SCL pin for GPS Bmx280 sensor.
        endmenu
    endmenu
endmenu
```

## Kconfig.projbuild
```kconfig
menu "ESPIDF Logger Common Configuration"
    choice
            default HAS_BOARD_LILYGO_T_DISPLAY_S3 if IDF_TARGET_ESP32S3
            default HAS_BOARD_LILYGO_EPAPER_T5 if IDF_TARGET_ESP32
            prompt "Select board"
            config HAS_BOARD_LILYGO_EPAPER_T5
                depends on IDF_TARGET_ESP32
                bool "Board is Lilygo Epaper T5"
            config HAS_BOARD_LILYGO_T_DISPLAY_S3
                depends on IDF_TARGET_ESP32S3
                bool "Board is Lilygo T-Display S3"
            config HAS_BOARD_LILYGO_T_DISPLAY_S3_AMOLED
                depends on IDF_TARGET_ESP32S3
                bool "Board is Lilygo T-Display S3 Amoled"
            config HAS_BOARD_QEMU_ESP32
                depends on IDF_TARGET_ESP32
                bool "Board is QEMU ESP32"
    endchoice
    if HAS_BOARD_LILYGO_EPAPER_T5
        config HAS_BOARD_LILYGO_EPAPER_T5_16MB_FLASH
            bool "Lilygo Epaper T5 16MB Flash version"
            default n
            help
                Select this if your Lilygo Epaper T5 board has 16MB flash memory.
    endif
    config BMX_ENABLE
        bool "Enable BMX280 temp sensor"
        default n
        help
            This option enables BMX280 temp sensor.
    if BMX_ENABLE
            menu "BMX temperature sensor pins"
                depends on BMX_ENABLE
                comment "GPS send and transmit pin configuration"
                config BMX_SDA
                    int "Bmx280 SDA pin"
                    default 43 if HAS_BOARD_LILYGO_T_DISPLAY_S3
                    default 21
                    help
                    Specify the SDA pin for Bmx280 sensor.
                config BMX_SCL
                    int "Bmx280 SCL pin"
                    default 44 if HAS_BOARD_LILYGO_T_DISPLAY_S3
                    default 22
                    help
                    Specify the SCL pin for GPS Bmx280 sensor.
            endmenu
    endif
    config LOGGER_COMMON_USE_CFG
        bool "Enable Configuration Module"
        default y
        help
            This option enables Configuration Module for GPS Logger.
    
        config LOGGER_VIBRATION_ENABLED
            bool "Enable vibration motor for haptic feedback"
            default y
            help
                Enable vibration motor control for button press feedback.
                Motor is controlled via GPIO output (simple on/off).
                WARNING: GPIO 34-39 on ESP32 (classic) are input-only.

        if LOGGER_VIBRATION_ENABLED
            menu "Logger Vibration Motor Options"
            config LOGGER_VIBRATION_GPIO
                int "Vibration motor GPIO pin"
                range 0 48
                default 12
                help
                    GPIO pin connected to vibration motor driver.
                    Ensure pin supports OUTPUT mode:
                    - ESP32: Avoid GPIO 34-39 (input-only, ADC pins)
                    - ESP32-S3: All GPIO 0-48 support output
                    Common safe choices: 13, 12, 27, 33 (ESP32)
            
            config LOGGER_VIBRATION_DEFAULT_DURATION_MS
                int "Default vibration pulse duration (milliseconds)"
                range 10 500
                default 100
                help
                    Default duration for vibration pulses when duration
                    parameter is 0. Typical values: 30-100ms for tactile
                    feedback, 200ms+ for alerts.
            
            config LOGGER_VIBRATION_ON_BUTTON_PRESS
                bool "Vibrate on button press (immediate feedback)"
                default y
                help
                    Trigger vibration immediately when button is pressed down.
                    Provides instant tactile feedback before event is recognized.
            
            config LOGGER_VIBRATION_ON_BUTTON_EVENT
                bool "Vibrate on button event (gesture completion)"
                default y
                help
                    Trigger vibration when button event is recognized
                    (single click, double click, long press, etc).
                    Confirms gesture was detected.
            endmenu
        endif
    
    config LOGGER_USE_WDT
        bool "Enable Watchdog Timer"
        default n
        help
            This option enables Watchdog Timer.
    config FLASH_PARTITIONS
        bool "Rewrite Flash Partitions"
        default n
        help
            This option enables rewriting Flash Partitions.
    config LOGGER_USE_GLOBAL_LOG_LEVEL
        bool "Use global log level"
        default n
        help
            This option enables global log level.
    if LOGGER_USE_GLOBAL_LOG_LEVEL
        choice 
            bool "Logger app default log verbosity"
            default LOGGER_GLOBAL_LOG_LEVEL_ERROR
            help
                Specify how important log should be added.
            config LOGGER_GLOBAL_LOG_LEVEL_TRACE
                bool "TRACE: A lot of logs to give detailed information"
            config LOGGER_GLOBAL_LOG_LEVEL_DEBUG
                bool "DEBUG: Log general debug info"
            config LOGGER_GLOBAL_LOG_LEVEL_INFO
                bool "INFO: Log important events"
            config LOGGER_GLOBAL_LOG_LEVEL_WARN
                bool "WARN: Log if something unwanted happened but didn't cause a problem"
            config LOGGER_GLOBAL_LOG_LEVEL_ERROR
                bool "ERROR: Only critical issues, when the system may fail"
            config LOGGER_GLOBAL_LOG_LEVEL_USER
                bool "USER: Only logs added by the user"
            config LOGGER_GLOBAL_LOG_LEVEL_NONE
                bool "NONE: Do not log anything"
        endchoice
        config LOGGER_GLOBAL_LOG_LEVEL
        int
        default 0 if LOGGER_GLOBAL_LOG_LEVEL_TRACE
        default 1 if LOGGER_GLOBAL_LOG_LEVEL_DEBUG
        default 2 if LOGGER_GLOBAL_LOG_LEVEL_INFO
        default 3 if LOGGER_GLOBAL_LOG_LEVEL_WARN
        default 4 if LOGGER_GLOBAL_LOG_LEVEL_ERROR
        default 5 if LOGGER_GLOBAL_LOG_LEVEL_USER
        default 6 if LOGGER_GLOBAL_LOG_LEVEL_NONE
    endif
    choice
        bool "Default log verbosity"
        default LOGGER_COMMON_LOG_LEVEL_ERROR
        help
            Specify how important log should be added.
        config LOGGER_COMMON_LOG_LEVEL_TRACE
            bool "TRACE: Log more to give detailed information"
        config LOGGER_COMMON_LOG_LEVEL_DEBUG
            bool "DEBUG: Log general debug info"
        config LOGGER_COMMON_LOG_LEVEL_INFO
            bool "INFO:  Log important events"
        config LOGGER_COMMON_LOG_LEVEL_WARN
            bool "WARN:  Log if something unwanted happened but didn't cause a problem"
        config LOGGER_COMMON_LOG_LEVEL_ERROR
            bool "ERROR: Only critical issues, when the system may fail"
        config LOGGER_COMMON_LOG_LEVEL_USER
            bool "USER:  Only logs added by the user"
        config LOGGER_COMMON_LOG_LEVEL_NONE
            bool "NONE:  Do not log anything"
    endchoice
    config LOGGER_COMMON_LOG_LEVEL
        int
        default 0 if LOGGER_COMMON_LOG_LEVEL_TRACE
        default 1 if LOGGER_COMMON_LOG_LEVEL_DEBUG
        default 2 if LOGGER_COMMON_LOG_LEVEL_INFO
        default 3 if LOGGER_COMMON_LOG_LEVEL_WARN
        default 4 if LOGGER_COMMON_LOG_LEVEL_ERROR
        default 5 if LOGGER_COMMON_LOG_LEVEL_USER
        default 6 if LOGGER_COMMON_LOG_LEVEL_NONE
endmenu
```
